/* test_flasher_xmodem.cpp: the XMODEM client for the MG24's Gecko
 * bootloader (Task 5b) against fixtures the firmware repo's own
 * xmodem.py produced, and against the GeckoBootloaderFake for the full
 * flash() sequence.
 *
 * The fixtures (fixtures/xmodem_layers.txt) were generated by the
 * controller from the firmware repo's platform/silabs/fw/xmodem.py
 * (crc16_xmodem, build_block(seq, payload, 128), and a full transcript
 * of a correct upload of the fixture's image: "1", the blocks in order,
 * EOT, "2"), so the C++ client is checked byte for byte against the
 * reference Python client rather than against a re-derivation of the
 * protocol. One named check per fixture line (crc, block, image, tx);
 * see the fixture's own header for the line formats.
 *
 * The end-to-end tests use test/host/GeckoBootloaderFake.h: the
 * bootloader as a host-side Stream, written by the controller as ground
 * truth (menu, "1" -> 17-byte echo then 'C', 128-byte SOH blocks
 * ACKed/NAKed exactly as the real one, EOT -> ACK + "Serial upload
 * complete" + the menu again, "2" -> runs). The fake queues its replies
 * only when the byte that triggers them is written, so the client sees
 * a request/response exchange, never pre-loaded bytes. Fault injection:
 * nakOnce(n), silentAfter(n), cancelAt(n), noMenu().
 *
 * The host clock moves only by g_yieldAdvanceMs (ArduinoShim.h): every
 * flash() call that may wait runs with it set to 50 and restores it to
 * 0 afterwards, so a wait that never finds its byte times out instead of
 * spinning forever.
 */
#include <stdio.h>
#include <string.h>
#include <vector>
#include <string>

#include "ArduinoShim.h"
#include "HearthBundle.h"              /* HearthByteSource */
#include "HearthFlasher.h"
#include "HearthFlasherXmodem.h"
#include "HearthFlasherXmodemInternal.h"   /* the layer functions, driven one at a time */
#include "GeckoBootloaderFake.h"

static int g_pass, g_fail;
static void check(const char *n, bool c) { printf("  [%s] %s\n", c ? "PASS" : "FAIL", n); (c ? g_pass : g_fail)++; }

/* A HearthByteSource over a memory buffer (the .gbl bytes). */
class ImgSource : public HearthByteSource {
public:
  std::vector<uint8_t> d;
  bool read(uint32_t off, uint8_t *buf, size_t n) override {
    if ((size_t)off + n > d.size()) return false;
    memcpy(buf, &d[off], n);
    return true;
  }
  uint32_t size() const override { return d.size(); }
};

static bool loadFixture(const char *path, std::string &out) {
  /* Try the path as-is first (CWD is test/host under make), then with
   * the test/host prefix (CWD is the repo root under the direct binary
   * invocation). */
  FILE *f = fopen(path, "rb");
  if (!f) {
    std::string prefixed = std::string("test/host/") + path;
    f = fopen(prefixed.c_str(), "rb");
  }
  if (!f) return false;
  int c;
  out.clear();
  while ((c = fgetc(f)) != EOF) out.push_back((char)c);
  fclose(f);
  return true;
}

/* Hex digit value, -1 when not a hex digit (either case). */
static int hexDigit(char c) {
  if (c >= '0' && c <= '9') return c - '0';
  if (c >= 'a' && c <= 'f') return c - 'a' + 10;
  if (c >= 'A' && c <= 'F') return c - 'A' + 10;
  return -1;
}

static bool parseHex(const std::string &s, std::vector<uint8_t> &out) {
  if (s.empty()) return false;
  if (s.size() % 2 != 0) return false;
  out.clear();
  for (size_t i = 0; i < s.size(); i += 2) {
    int hi = hexDigit(s[i]), lo = hexDigit(s[i + 1]);
    if (hi < 0 || lo < 0) return false;
    out.push_back((uint8_t)((hi << 4) | lo));
  }
  return true;
}

/* Parse the fixture's four hex digits into a 16-bit value, or -1 when the
 * field is not four hex digits. */
static int parseCrc4(const std::string &s) {
  if (s.size() != 4) return -1;
  int v = 0;
  for (size_t i = 0; i < s.size(); i++) {
    int d = hexDigit(s[i]);
    if (d < 0) return -1;
    v = (v << 4) | d;
  }
  return v;
}

/* The pins the CPico carriers of the MG24 wire: UART GP0/GP1, reset GP2,
 * strap GP3 (active low). The host no-op helpers only report the pin's
 * availability, so any non-negative number stands in. */
static HearthCoprocPins mg24Pins() {
  HearthCoprocPins p;
  p.reset = 2; p.resetActiveLow = true;
  p.strap = 3; p.strapActiveLow = true;
  return p;
}

/*
 * A receiver that goes silent part-way through the transfer: it behaves
 * as a correct Gecko bootloader until the last byte of block n has
 * landed, after which it answers nothing at all (a dropped frame on the
 * wire, not a NAK). It records every byte the client writes so the test
 * can count the retransmissions block n received.
 */
class SilentAfterBlockStream : public Stream {
public:
  SilentAfterBlockStream() { _rx = menu(); }
  void silentAfter(int block) { _silentAfter = block; }
  const std::vector<uint8_t> &tx() const { return _tx; }
  int blocksSeen(int n) const { return _seen[n - 1]; }

  size_t write(uint8_t c) override {
    _tx.push_back(c);
    if (_silent) return 1;
    if (_state == MENU && c == '1') {
      _rx += "\r\nbegin upload\r\n\0";
      _rx += "C";
      _state = XFER;
    } else if (_state == XFER) {
      _frame.push_back(c);
      if (_frame.size() == 133 && _frame[0] == 0x01 && _frame[1] != 0) {
        int n = _frame[1];
        _seen[n - 1]++;
        bool good = _frame[2] == (uint8_t)(0xFF - n);
        uint16_t want = 0;
        for (size_t i = 0; i < 128; i++) {
          want ^= (uint16_t)((uint16_t)_frame[3 + i] << 8);
          for (int b = 0; b < 8; b++) {
            want = (want & 0x8000) ? (uint16_t)((want << 1) ^ 0x1021) : (uint16_t)(want << 1);
          }
        }
        good = good && want == ((uint16_t)_frame[131] << 8 | (uint16_t)_frame[132]);
        _frame.clear();
        if (!good) {
          _rx += "\x15";
          return 1;
        }
        if (_silentAfter > 0 && n >= _silentAfter) {
          _silent = true;
          return 1;   /* block n itself gets no reply either */
        }
        _rx += "\x06";
      }
    }
    return 1;
  }
  int available() override { return (int)_rx.size(); }
  int read() override {
    if (_rx.empty()) return -1;
    int c = (unsigned char)_rx[0];
    _rx.erase(0, 1);
    return c;
  }
  int peek() override { return _rx.empty() ? -1 : (unsigned char)_rx[0]; }

private:
  enum State { MENU, XFER };
  static std::string menu() {
    return std::string("\r\nGecko Bootloader v3.02.01\r\n1. upload gbl\r\n2. run\r\n3. ebl info\r\nBL > ")
           + std::string(1, '\0');
  }
  std::string _rx;
  std::vector<uint8_t> _tx, _frame;
  int _seen[256] = {0};
  State _state = MENU;
  int _silentAfter = 0;
  bool _silent = false;
};

int main() {
  /* ---- 1. every crc line of the fixture: the client's CRC ---- */
  {
    std::string fx;
    check("fixture xmodem_layers.txt loads", loadFixture("fixtures/xmodem_layers.txt", fx));
    std::vector<std::string> fl;
    {
      std::string cur;
      for (size_t i = 0; i < fx.size(); i++) {
        if (fx[i] == '\n') { fl.push_back(cur); cur.clear(); }
        else cur.push_back(fx[i]);
      }
      if (!cur.empty()) fl.push_back(cur);
    }
    int lineNo = 0, crcLines = 0;
    for (size_t i = 0; i < fl.size(); i++) {
      lineNo++;
      if (fl[i].empty() || fl[i][0] == '#') continue;
      if (fl[i].compare(0, 4, "crc ") != 0) continue;
      crcLines++;
      std::string rest = fl[i].substr(4);
      size_t sp = rest.find(' ');
      std::string inS = sp == std::string::npos ? "" : rest.substr(0, sp);
      std::string crcS = sp == std::string::npos ? "" : rest.substr(sp + 1);
      std::vector<uint8_t> in;
      bool gotIn = inS == "-" || parseHex(inS, in);
      int expect = parseCrc4(crcS);
      char name[96];
      snprintf(name, sizeof(name), "crc line %d: crc16-xmodem matches the oracle", lineNo);
      check(name, gotIn && expect >= 0 && (int)xmodemCrc16(in.data(), in.size()) == expect);
    }
    check("the fixture carried at least one crc line", crcLines > 0);
  }

  /* ---- 2. every block line of the fixture: the client's builder ---- */
  {
    std::string fx;
    loadFixture("fixtures/xmodem_layers.txt", fx);
    std::vector<std::string> fl;
    {
      std::string cur;
      for (size_t i = 0; i < fx.size(); i++) {
        if (fx[i] == '\n') { fl.push_back(cur); cur.clear(); }
        else cur.push_back(fx[i]);
      }
      if (!cur.empty()) fl.push_back(cur);
    }
    int lineNo = 0, blockLines = 0;
    for (size_t i = 0; i < fl.size(); i++) {
      lineNo++;
      if (fl[i].empty() || fl[i][0] == '#') continue;
      if (fl[i].compare(0, 6, "block ") != 0) continue;
      blockLines++;
      /* block <seq> <payload hex or -> <133-byte block hex> */
      std::string rest = fl[i].substr(6);
      size_t sp = rest.find(' ');
      std::string seqS = sp == std::string::npos ? "" : rest.substr(0, sp);
      rest = sp == std::string::npos ? "" : rest.substr(sp + 1);
      sp = rest.find(' ');
      std::string payS = sp == std::string::npos ? "" : rest.substr(0, sp);
      std::string wantS = sp == std::string::npos ? "" : rest.substr(sp + 1);
      int seq = 0;
      for (size_t k = 0; k < seqS.size(); k++) {
        if (seqS[k] < '0' || seqS[k] > '9') { seq = -1; break; }
        seq = seq * 10 + (seqS[k] - '0');
      }
      std::vector<uint8_t> pay, want;
      bool ok = seq >= 1 && seq <= 256 && (payS == "-" || parseHex(payS, pay)) && parseHex(wantS, want) && want.size() == 133;
      if (ok) {
        if (pay.size() > 128) ok = false;
        else {
          uint8_t out[133];
          xmodemBuildBlock(out, (uint8_t)seq, pay.empty() ? 0 : pay.data(), pay.size());
          ok = memcmp(out, want.data(), 133) == 0;
        }
      }
      char name[96];
      snprintf(name, sizeof(name), "block line %d: builder emits exactly the fixture's 133 bytes (seq %s)", lineNo, seqS.c_str());
      check(name, ok);
    }
    check("the fixture carried at least one block line", blockLines > 0);
  }

  /* ---- 3. the transcript: a full flash() against a fresh fake ---- */
  {
    std::string fx;
    loadFixture("fixtures/xmodem_layers.txt", fx);
    std::vector<std::string> fl;
    {
      std::string cur;
      for (size_t i = 0; i < fx.size(); i++) {
        if (fx[i] == '\n') { fl.push_back(cur); cur.clear(); }
        else cur.push_back(fx[i]);
      }
      if (!cur.empty()) fl.push_back(cur);
    }
    std::vector<uint8_t> image, wantTx;
    for (size_t i = 0; i < fl.size(); i++) {
      if (fl[i].compare(0, 6, "image ") == 0) parseHex(fl[i].substr(6), image);
      else if (fl[i].compare(0, 3, "tx ") == 0) parseHex(fl[i].substr(3), wantTx);
    }
    check("the fixture's image and transcript lines parse", !image.empty() && !wantTx.empty());

    /* A 300-byte source: three 128-byte blocks, the last padded 0x1A. */
    std::vector<uint8_t> img300(300);
    for (int i = 0; i < 300; i++) img300[i] = (uint8_t)(i & 0xFF);
    ImgSource src;
    src.d = img300;
    const uint8_t sha[32] = {0};

    GeckoBootloaderFake fake;
    HearthCoprocPins pins = mg24Pins();
    HearthFlasherXmodem f;
    g_yieldAdvanceMs = 50;
    int r = f.flash(fake, pins, src, 0, 300, sha);
    g_yieldAdvanceMs = 0;

    check("a 300-byte upload completes against the fake", r == 0);
    check("the fake accepted 3 blocks (128 + 128 + 44)", fake.blocksAccepted() == 3);
    /* 300-byte source: blocks of 128, 128, 44. The last block (image
     * bytes 256..383) carries 44 real bytes then 84 of 0x1A padding. */
    check("the last block was padded with 0x1A to 128",
          fake.image().size() == 384 &&
          fake.image()[300] == 0x1A && fake.image()[383] == 0x1A);
    check("block 1's CRC is the oracle's value for its payload",
          fake.image().size() == 384 &&
          (int)GeckoBootloaderFake::crc16(&fake.image()[0], 128) ==
            (int)xmodemCrc16(img300.data(), 128));
    check("no STX (1K) block was ever sent", fake.stxSeen() == 0);
    check("the fake ran the application ('2' sent last)", fake.ran());
    {
      /* The flasher's own writes: "1" to start the upload, the blocks,
       * EOT, then "2" to run. The block payloads carry arbitrary data
       * (which may include 0x32), so the assertion is on the first and
       * last control byte, not on a count of "2"s. */
      const std::vector<uint8_t> &tx = fake.tx();
      bool ok = !tx.empty() && tx[0] == '1' && tx[tx.size() - 1] == '2';
      /* The byte before the final "2" is the EOT (0x04). */
      ok = ok && tx.size() >= 2 && tx[tx.size() - 2] == 0x04;
      check("'1' opens the upload and '2' (after EOT) is the final byte", ok);
    }

    /* The transcript: flash() of the fixture's image writes exactly the
     * fixture's tx bytes, and the fake's stored image is the image
     * padded to 128 with 0x1A. */
    GeckoBootloaderFake t2;
    ImgSource tsrc;
    tsrc.d = image;
    g_yieldAdvanceMs = 50;
    int r2 = f.flash(t2, pins, tsrc, 0, (uint32_t)image.size(), sha);
    g_yieldAdvanceMs = 0;
    check("the transcript upload completes", r2 == 0);
    check("the transcript upload wrote exactly the fixture's tx bytes", t2.tx() == wantTx);
    {
      std::vector<uint8_t> wantImage = image;
      while (wantImage.size() % 128 != 0) wantImage.push_back(0x1A);
      check("the fake stored the image padded to 128 with 0x1A", t2.image() == wantImage);
      check("the transcript upload reports complete and runs", t2.uploadComplete() && t2.ran());
    }
  }

  /* ---- 4a. a NAK once: one resend, then the transfer completes ---- */
  {
    std::vector<uint8_t> img300(300);
    for (int i = 0; i < 300; i++) img300[i] = (uint8_t)(i & 0xFF);
    ImgSource src;
    src.d = img300;
    const uint8_t sha[32] = {0};
    HearthCoprocPins pins = mg24Pins();

    GeckoBootloaderFake fake;
    fake.nakOnce(2);
    HearthFlasherXmodem f;
    g_yieldAdvanceMs = 50;
    int r = f.flash(fake, pins, src, 0, 300, sha);
    g_yieldAdvanceMs = 0;
    check("a NAKed block is resent and the upload completes", r == 0);
    check("exactly one NAK was sent (block 2, once)", fake.naksSent() == 1);
    check("all 3 blocks were accepted (the resend re-ACKed block 2)", fake.blocksAccepted() == 3);
    check("the NAK run still runs the application", fake.ran());
    /* The tx carries block 2 twice in a row: count the SOH blocks with
     * seq 2. */
    {
      int seq2 = 0;
      const std::vector<uint8_t> &tx = fake.tx();
      for (size_t i = 0; i + 2 < tx.size(); i++) {
        if (tx[i] == 0x01 && tx[i + 1] == 2 && tx[i + 2] == 0xFD) seq2++;
      }
      check("the transcript shows block 2 sent twice (NAK, resend)", seq2 == 2);
    }
  }

  /* ---- 4b. a silent receiver: the missing reply is fatal, no resend ---- */
  {
    std::vector<uint8_t> img300(300);
    for (int i = 0; i < 300; i++) img300[i] = (uint8_t)(i & 0xFF);
    ImgSource src;
    src.d = img300;
    const uint8_t sha[32] = {0};
    HearthCoprocPins pins = mg24Pins();

    SilentAfterBlockStream s;
    s.silentAfter(2);
    HearthFlasherXmodem f;
    g_yieldAdvanceMs = 50;
    int r = f.flash(s, pins, src, 0, 300, sha);
    g_yieldAdvanceMs = 0;
    check("a missing reply after block 2 is HEARTH_FLASH_ERR_PROTOCOL", r == HEARTH_FLASH_ERR_PROTOCOL);
    check("block 2 went out exactly once (no retransmit without a NAK)", s.blocksSeen(2) == 1);
    check("nothing was sent after the silent block 2", s.blocksSeen(3) == 0);

    /* The ground-truth fake with its own silentAfter(2) agrees. */
    GeckoBootloaderFake fake;
    fake.silentAfter(2);
    g_yieldAdvanceMs = 50;
    int r2 = f.flash(fake, pins, src, 0, 300, sha);
    g_yieldAdvanceMs = 0;
    check("the fake's silentAfter(2) gives the same fatal result", r2 == HEARTH_FLASH_ERR_PROTOCOL);
    check("the fake sent no NAK and accepted only block 1", fake.naksSent() == 0 && fake.blocksAccepted() == 1);
  }

  /* ---- 4c. a CAN at block 2: the transfer aborts ---- */
  {
    std::vector<uint8_t> img300(300);
    for (int i = 0; i < 300; i++) img300[i] = (uint8_t)(i & 0xFF);
    ImgSource src;
    src.d = img300;
    const uint8_t sha[32] = {0};
    HearthCoprocPins pins = mg24Pins();

    GeckoBootloaderFake fake;
    fake.cancelAt(2);
    HearthFlasherXmodem f;
    g_yieldAdvanceMs = 50;
    int r = f.flash(fake, pins, src, 0, 300, sha);
    g_yieldAdvanceMs = 0;
    check("a CAN at block 2 is HEARTH_FLASH_ERR_PROTOCOL", r == HEARTH_FLASH_ERR_PROTOCOL);
    check("the cancellation accepted only block 1 and ran nothing", fake.blocksAccepted() == 1 && !fake.ran());
  }

  /* ---- 4d. no menu: the module never entered the bootloader ---- */
  {
    std::vector<uint8_t> img300(300);
    for (int i = 0; i < 300; i++) img300[i] = (uint8_t)(i & 0xFF);
    ImgSource src;
    src.d = img300;
    const uint8_t sha[32] = {0};
    HearthCoprocPins pins = mg24Pins();

    GeckoBootloaderFake fake;
    fake.noMenu();
    HearthFlasherXmodem f;
    g_yieldAdvanceMs = 50;
    int r = f.flash(fake, pins, src, 0, 300, sha);
    g_yieldAdvanceMs = 0;
    check("no menu is HEARTH_FLASH_ERR_ENTER", r == HEARTH_FLASH_ERR_ENTER);
  }

  /* ---- 4e. pins of -1: refused before anything is written ---- */
  {
    std::vector<uint8_t> img300(300);
    for (int i = 0; i < 300; i++) img300[i] = (uint8_t)(i & 0xFF);
    ImgSource src;
    src.d = img300;
    const uint8_t sha[32] = {0};

    HearthCoprocPins none;
    none.reset = -1; none.resetActiveLow = true;
    none.strap = -1; none.strapActiveLow = true;

    GeckoBootloaderFake fake;
    HearthFlasherXmodem f;
    g_yieldAdvanceMs = 50;
    int r = f.flash(fake, none, src, 0, 300, sha);
    g_yieldAdvanceMs = 0;
    check("pins of -1 refuse with HEARTH_FLASH_ERR_ENTER", r == HEARTH_FLASH_ERR_ENTER);
    check("nothing was written to the stream", fake.tx().empty());

    HearthCoprocPins noStrap;
    noStrap.reset = 2; noStrap.resetActiveLow = true;
    noStrap.strap = -1; noStrap.strapActiveLow = true;
    GeckoBootloaderFake fake2;
    g_yieldAdvanceMs = 50;
    int r2 = f.flash(fake2, noStrap, src, 0, 300, sha);
    g_yieldAdvanceMs = 0;
    check("a strap of -1 alone also refuses, nothing written", r2 == HEARTH_FLASH_ERR_ENTER && fake2.tx().empty());
  }

  /* ---- 5. forModel: the registry ---- */
  {
    check("MGM240P Hearth -> the XMODEM flasher", HearthFlasher::forModel("MGM240P Hearth") != nullptr);
    check("nRF54L15 Hearth -> the SMP flasher still", HearthFlasher::forModel("nRF54L15 Hearth") != nullptr);
    check("nRF54LM20A Hearth -> the SMP flasher still", HearthFlasher::forModel("nRF54LM20A Hearth") != nullptr);
    /* 5c registered the ESP ROM loader for the C6; it is a different
     * instance from the XMODEM one, so this test (the XMODEM family) only
     * asserts it is not the XMODEM object. */
    check("ESP32-C6 Hearth -> a flasher, not the XMODEM one (5c)",
          HearthFlasher::forModel("ESP32-C6 Hearth") != nullptr &&
          HearthFlasher::forModel("ESP32-C6 Hearth") != HearthFlasher::forModel("MGM240P Hearth"));
    check("an unknown model -> nullptr", HearthFlasher::forModel("Ophelia-IV") == nullptr);
    check("the XMODEM instance is a stable library-owned static",
          HearthFlasher::forModel("MGM240P Hearth") == HearthFlasher::forModel("MGM240P Hearth"));
    check("the two families hand out different instances",
          HearthFlasher::forModel("MGM240P Hearth") != HearthFlasher::forModel("nRF54L15 Hearth"));
  }

  printf("\n===== RESULT: %d passed, %d failed =====\n", g_pass, g_fail);
  return g_fail ? 1 : 0;
}

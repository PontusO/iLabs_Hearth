/* test_flasher_smp.cpp: the SMP serial-recovery client (Task 5a) against
 * fixtures the firmware repo's own smp.py produced, and against a
 * scripted MockStream for the full flash() sequence.
 *
 * The fixtures (fixtures/smp_upload0.txt, fixtures/smp_echo.txt) were
 * generated by running smp.py's encode_frame()/serial_encode() on the
 * first upload chunk of a 600-byte image (the same image this test
 * builds, content (i*7+3) & 0xFF, the MCUboot ih_magic 0x96F3B83D
 * little-endian at offset 0) and on the echo command, so the C++
 * encoder is checked byte for byte against the reference Python client
 * rather than against a re-derivation of the protocol. The payload
 * construction is flash.py's upload() itself: the first chunk's map is
 * {"image": 0, "data": chunk, "off": 0} with "len" and "sha" added on
 * the first chunk only, and its dict order (image, data, off, len, sha)
 * is the wire order. The sequence numbers are flash.py's: its
 * SeqCounter starts at 0 and pre-increments, the handshake (flash.py
 * 252-270) takes seq 1 and the first upload chunk (flash.py 271-332)
 * seq 2. Rerun from test/host/:
 *
 *   import sys
 *   sys.path.insert(0, '/mnt/f86c891c-33c6-4bb7-afe1-2c8846257177/src/git/iLabs_AT_Hearth/platform/nrf54l15/fw')
 *   import smp
 *   image = bytearray((i * 7 + 3) & 0xFF for i in range(600))
 *   image[0:4] = (0x3D, 0xB8, 0xF3, 0x96)   # ih_magic, little-endian
 *   CHUNK = 512                             # flash.py CHUNK
 *   chunk0 = bytes(image[0:CHUNK])
 *   sha = bytes(32)
 *   echo = smp.serial_encode(smp.encode_frame(smp.NMGR_OP_WRITE, smp.MGMT_GROUP_ID_DEFAULT,
 *                                             smp.NMGR_ID_ECHO, {"d": "hearth"}, 1))
 *   up0 = smp.serial_encode(smp.encode_frame(smp.NMGR_OP_WRITE, smp.MGMT_GROUP_ID_IMAGE,
 *                                            smp.IMGMGR_NMGR_ID_UPLOAD,
 *                                            {"image": 0, "data": chunk0, "off": 0,
 *                                             "len": len(image), "sha": sha}, 2))
 *   open('fixtures/smp_echo.txt', 'wb').write(echo)
 *   open('fixtures/smp_upload0.txt', 'wb').write(up0)
 *
 * The reply maps are hand-built CBOR in both the definite and the
 * indefinite form, because this MCUboot build leaves
 * CONFIG_ZCBOR_CANONICAL unset and answers with 0xBF ... 0xFF maps. */
#include <stdio.h>
#include <string.h>
#include <vector>
#include <string>
#include <deque>

#include "ArduinoShim.h"
#include "MockStream.h"
#include "HearthBundle.h"   /* HearthByteSource */
#include "HearthFlasher.h"
#include "HearthFlasherSmp.h"
#include "HearthFlasherSmpInternal.h"   /* the layer functions, driven one at a time */

static int g_pass, g_fail;
static void check(const char *n, bool c) { printf("  [%s] %s\n", c ? "PASS" : "FAIL", n); (c ? g_pass : g_fail)++; }

/* The image under test: 600 bytes, deterministic, with the MCUboot
 * image_header magic (0x96F3B83D, little-endian) at offset 0. */
static std::vector<uint8_t> makeImage(uint32_t n) {
  std::vector<uint8_t> d(n);
  for (uint32_t i = 0; i < n; i++) d[i] = (uint8_t)((i * 7 + 3) & 0xFF);
  d[0] = 0x3D; d[1] = 0xB8; d[2] = 0xF3; d[3] = 0x96;   /* ih_magic LE */
  return d;
}

static bool loadFixture(const char *path, std::string &out) {
  /* Try the path as-is first (CWD is test/host under make run), then with
   * the test/host prefix (CWD is the repo root under the direct binary
   * invocation). */
  FILE *f = fopen(path, "rb");
  if (!f) {
    std::string prefixed = std::string("test/host/") + path;
    f = fopen(prefixed.c_str(), "rb");
  }
  if (!f) return false;
  int c;
  out.clear();
  while ((c = fgetc(f)) != EOF) out.push_back((char)c);
  fclose(f);
  return true;
}

/* A HearthByteSource over a memory buffer. */
class ImgSource : public HearthByteSource {
public:
  std::vector<uint8_t> d;
  bool read(uint32_t off, uint8_t *buf, size_t n) override {
    if ((size_t)off + n > d.size()) return false;
    memcpy(buf, &d[off], n);
    return true;
  }
  uint32_t size() const override { return d.size(); }
};

/* base64 char -> 6-bit value, -1 outside the alphabet (the standard
 * A-Za-z0-9+/ alphabet the SMP packet framing uses). */
static int smpB64CharValue(char c) {
  if (c >= 'A' && c <= 'Z') return c - 'A';
  if (c >= 'a' && c <= 'z') return c - 'a' + 26;
  if (c >= '0' && c <= '9') return c - '0' + 52;
  if (c == '+') return 62;
  if (c == '/') return 63;
  return -1;
}

/*
 * A MockStream that records every transmitted line, for the frame
 * count, and releases each queued reply only when the client has
 * finished writing the request frame the reply answers (frame #0's
 * reply after frame #0, and so on). A real bootloader does not put all
 * of its replies on the wire before the first request has finished
 * transmitting, so the client's frame-keeping read loop must be checked
 * against that behaviour. A line opens a frame only when its marker is
 * the start marker (0x06 0x09); the opener's first four base64
 * characters are the packet's totlen, which fixes the frame's total
 * base64 length, and the continuation lines (0x04 0x14) are tracked
 * against that total until the frame is complete.
 */
class ScriptedSmpStream : public MockStream {
public:
  int lines() const { return (int)_tx.size(); }
  const std::vector<std::string> &tx() const { return _tx; }
  void queueReply(const std::string &bytes) { _replies.push_back(bytes); }
  size_t write(uint8_t c) override {
    if (c == '\n') {
      _tx.push_back(_cur);
      /* The recorded line is marker + base64; b64len is the base64 run. */
      size_t runLen = _cur.size();
      size_t b64len = runLen > 2 ? runLen - 2 : 0;
      bool isOpener = (b64len >= 4 && (unsigned char)_tx.back()[0] == 0x06
                       && (unsigned char)_tx.back()[1] == 0x09);
      _cur.clear();
      /*
       * The line just closed opens a request frame only when its own
       * marker is the start marker (0x06 0x09); continuation lines
       * (0x04 0x14) are tracked against the opener's totlen. The
       * frame-keeping read loop (HearthFlasherSmp.cpp) writes a request
       * and then reads, so a reply's lines always arrive and are written
       * out between frames: only an opener can open a frame.
       */
      if (isOpener) {
        /* The opener's first four base64 characters are the packet's
         * totlen (a 2-byte value needs exactly 4 base64 characters). */
        size_t b64val = 0;
        for (int i = 2; i < 6 && i < (int)_tx.back().size(); i++) {
          b64val = (b64val << 6) | (size_t)(unsigned char)smpB64CharValue(_tx.back()[i]);
        }
        size_t totlen = (b64val >> 8) & 0xFFFF;
        /* The packet is totlen(2) + frame + crc(2) = totlen + 2 bytes,
         * base64 as a whole: ceil((totlen + 2) / 3) * 4 characters. */
        size_t b64total = (totlen + 2 + 2) / 3 * 4;
        _frameChars = b64total > b64len ? b64total - b64len : 0;
      } else if (_frameChars) {
        /* Continuation line: burn off its share of the frame's base64. */
        if (_frameChars <= b64len) {
          _frameChars = 0;
        } else {
          _frameChars -= b64len;
        }
      }
      if (_frameChars == 0 && !_replies.empty()) {
        /* The frame the client just finished is the one this reply
         * answers; a real bootloader's answer lands only now. */
        injectRaw(_replies.front());
        _replies.pop_front();
      }
      return MockStream::write(c);
    }
    _cur.push_back((char)c);
    return MockStream::write(c);
  }
private:
  std::string _cur;
  std::vector<std::string> _tx;
  std::deque<std::string> _replies;
  size_t _frameChars = 0;
};

/*
 * Build one reply packet (the base64 lines a real bootloader would send)
 * for a frame whose CBOR payload is cbor: header op/flags/len/group/seq/
 * id, the packet's totlen and CRC, the 124-char line split.
 * cbor is a raw byte array (not a C string), because the payloads carry
 * 0x00 bytes that a C string cannot hold.
 */
static std::string encodeReplyLines(uint8_t op, uint16_t group, uint8_t seq, uint8_t id,
                                    const uint8_t *cbor, size_t cborLen) {
  std::vector<uint8_t> frame;
  frame.push_back(op);
  frame.push_back(0);
  frame.push_back((uint8_t)(cborLen >> 8));
  frame.push_back((uint8_t)cborLen);
  frame.push_back((uint8_t)(group >> 8));
  frame.push_back((uint8_t)group);
  frame.push_back(seq);
  frame.push_back(id);
  frame.insert(frame.end(), cbor, cbor + cborLen);

  uint16_t crc = 0;
  for (size_t i = 0; i < frame.size(); i++) {
    crc ^= (uint16_t)((uint16_t)frame[i] << 8);
    for (int b = 0; b < 8; b++) {
      crc = (crc & 0x8000) ? (uint16_t)((crc << 1) ^ 0x1021) : (uint16_t)(crc << 1);
    }
  }
  std::vector<uint8_t> raw;
  uint16_t totlen = (uint16_t)(frame.size() + 2);
  raw.push_back((uint8_t)(totlen >> 8));
  raw.push_back((uint8_t)totlen);
  raw.insert(raw.end(), frame.begin(), frame.end());
  raw.push_back((uint8_t)(crc >> 8));
  raw.push_back((uint8_t)crc);

  static const char alpha[] = "ABCDEFGHIJKLMNOPQRSTUVWXYZabcdefghijklmnopqrstuvwxyz0123456789+/";
  std::string b64;
  for (size_t i = 0; i < raw.size(); i += 3) {
    uint32_t v = (uint32_t)raw[i] << 16;
    int n = (int)(raw.size() - i);
    if (n >= 2) v |= (uint32_t)raw[i + 1] << 8;
    if (n >= 3) v |= raw[i + 2];
    b64.push_back(alpha[(v >> 18) & 63]);
    b64.push_back(alpha[(v >> 12) & 63]);
    b64.push_back(n > 1 ? alpha[(v >> 6) & 63] : '=');
    b64.push_back(n > 2 ? alpha[v & 63] : '=');
  }
  std::string out;
  for (size_t off = 0; off < b64.size(); off += 124) {
    if (off == 0) out += "\x06\x09"; else out += "\x04\x14";
    out += b64.substr(off, 124);
    out += "\n";
  }
  return out;
}

/*
 * The CBOR reply payloads, as raw byte arrays (not C strings, because
 * several carry 0x00 bytes). Each is the exact bytes the reference
 * smp.py would produce for the same map.
 */
static const uint8_t REPLY_ECHO_INDEF[] = {0xBF,0x62,0x72,0x63,0x08,0xFF};
#define REPLY_ECHO_INDEF_LEN 6
static const uint8_t REPLY_ECHO_DEF[] = {0xA1,0x62,0x72,0x63,0x08};
#define REPLY_ECHO_DEF_LEN 5
static const uint8_t REPLY_UP_OFF448_INDEF[] = {0xBF,0x62,0x72,0x63,0x00,0x63,0x6F,0x66,0x66,0x19,0x01,0xC0,0xFF};
#define REPLY_UP_OFF448_INDEF_LEN 13
static const uint8_t REPLY_UP_OFF448_DEF[] = {0xA2,0x62,0x72,0x63,0x00,0x63,0x6F,0x66,0x66,0x19,0x01,0xC0};
#define REPLY_UP_OFF448_DEF_LEN 12
static const uint8_t REPLY_UP_OFF600_INDEF[] = {0xBF,0x62,0x72,0x63,0x00,0x63,0x6F,0x66,0x66,0x19,0x02,0x58,0xFF};
#define REPLY_UP_OFF600_INDEF_LEN 13
static const uint8_t REPLY_UP_RC3_INDEF[] = {0xBF,0x62,0x72,0x63,0x03,0xFF};
#define REPLY_UP_RC3_INDEF_LEN 6

/* ---- the layered oracles (fixtures/smp_layers.txt) ----
 * The fixture was generated by the controller from the firmware repo's
 * smp.py; one named check per fixture line, so a failure names the layer
 * and the case. Line formats (see the fixture's own header):
 *   crc <input hex or -> <crc16-xmodem, 4 hex digits>
 *   frame <frame hex> <padding count> <n> then n lines "line <text>"
 *   cbor <cbor hex> <rc or -> <off or ->    (- = the key is absent)
 */

/* Hex digit value, -1 when not a hex digit (either case). */
static int hexDigit(char c) {
  if (c >= '0' && c <= '9') return c - '0';
  if (c >= 'a' && c <= 'f') return c - 'a' + 10;
  if (c >= 'A' && c <= 'F') return c - 'A' + 10;
  return -1;
}

static bool parseHex(const std::string &s, std::vector<uint8_t> &out) {
  if (s.size() % 2 != 0) return false;
  out.clear();
  for (size_t i = 0; i < s.size(); i += 2) {
    int hi = hexDigit(s[i]), lo = hexDigit(s[i + 1]);
    if (hi < 0 || lo < 0) return false;
    out.push_back((uint8_t)((hi << 4) | lo));
  }
  return true;
}

/* Parse the fixture's four hex digits into a 16-bit value, or -1 when the
 * field is not four hex digits. */
static int parseCrc4(const std::string &s) {
  if (s.size() != 4) return -1;
  int v = 0;
  for (size_t i = 0; i < 4; i++) {
    int d = hexDigit(s[i]);
    if (d < 0) return -1;
    v = (v << 4) | d;
  }
  return v;
}

/* Decode one fixture line: the <06><09> and <04><14> tokens stand for
 * those bytes, everything else is literal. Returns false on an unknown
 * <token> or an odd < token. */
static bool decodeFixLine(const std::string &text, std::string &out) {
  out.clear();
  for (size_t i = 0; i < text.size(); i++) {
    if (text[i] != '<') {
      out.push_back(text[i]);
      continue;
    }
    size_t e = text.find('>', i);
    if (e == std::string::npos) return false;
    std::string tok = text.substr(i + 1, e - i - 1);
    if (tok.size() < 2) return false;
    int v = 0;
    for (size_t k = 0; k < tok.size(); k++) {
      int d = hexDigit(tok[k]);
      if (d < 0) return false;
      v = (v << 4) | d;
    }
    out.push_back((char)v);
    i = e;
  }
  return true;
}

/* The serial encoder's output sink: it records the bytes smpWriteFrameLines()
 * writes, byte by byte, and the helper below splits them into lines. */
class CaptureStream : public Stream {
public:
  std::string bytes;
  size_t write(uint8_t c) override { bytes.push_back((char)c); return 1; }
  int available() override { return 0; }
  int read() override { return -1; }
  int peek() override { return -1; }
};

static std::vector<std::string> linesOf(const std::string &b) {
  std::vector<std::string> out;
  std::string cur;
  for (size_t i = 0; i < b.size(); i++) {
    if (b[i] == '\n') {
      out.push_back(cur);
      cur.clear();
    } else {
      cur.push_back(b[i]);
    }
  }
  if (!cur.empty()) out.push_back(cur);
  return out;
}

int main() {
  /* ---- the layered oracles, one named check per fixture line ---- */
  {
    std::string fx;
    check("fixture smp_layers.txt loads", loadFixture("fixtures/smp_layers.txt", fx));
    std::vector<std::string> fl;
    {
      std::string cur;
      for (size_t i = 0; i < fx.size(); i++) {
        if (fx[i] == '\n') {
          fl.push_back(cur);
          cur.clear();
        } else {
          cur.push_back(fx[i]);
        }
      }
      if (!cur.empty()) fl.push_back(cur);
    }
    int lineNo = 0;
    size_t i = 0;
    while (i < fl.size()) {
      lineNo++;
      if (fl[i].empty() || fl[i][0] == '#') {
        i++;
        continue;
      }
      /* ---- crc <input hex or -> <crc16-xmodem, 4 hex digits> ---- */
      if (fl[i].compare(0, 4, "crc ") == 0) {
        std::string rest = fl[i].substr(4);
        size_t sp = rest.find(' ');
        std::string inS = sp == std::string::npos ? "" : rest.substr(0, sp);
        std::string crcS = sp == std::string::npos ? "" : rest.substr(sp + 1);
        std::vector<uint8_t> in;
        bool gotIn = inS == "-" || parseHex(inS, in);
        int expect = parseCrc4(crcS);
        char name[96];
        snprintf(name, sizeof(name), "crc line %d: crc16-xmodem matches the oracle", lineNo);
        check(name, gotIn && expect >= 0 && (int)smpCrc16(in.data(), in.size()) == expect);
        i++;
        continue;
      }
      /* ---- frame <frame hex> <padding count> <n>, then n "line" rows ---- */
      if (fl[i].compare(0, 6, "frame ") == 0) {
        std::vector<std::string> tok;
        for (size_t j = i + 1; j < fl.size() && fl[j].compare(0, 5, "line ") == 0; j++) {
          tok.push_back(fl[j].substr(5));
        }
        /* The frame line is "frame <hex> <pad> <n>"; the hex is the first field. */
        size_t fp = fl[i].find(' ', 6);
        std::string frameHex = fp == std::string::npos ? fl[i].substr(6) : fl[i].substr(6, fp - 6);
        std::vector<uint8_t> frame;
        bool ok = parseHex(frameHex, frame) && !tok.empty();
        /* The encoder: the client's lines must be exactly the fixture's. */
        CaptureStream cap;
        if (ok) smpWriteFrameLines(cap, frame.data(), frame.size());
        std::vector<std::string> got = linesOf(cap.bytes);
        bool encOk = ok && got.size() == tok.size();
        for (size_t k = 0; ok && k < tok.size(); k++) {
          std::string want;
          ok = ok && decodeFixLine(tok[k], want) && got[k] == want;
        }
        encOk = ok;
        char name[96];
        snprintf(name, sizeof(name), "frame line %d: encoder emits exactly the fixture's %d line(s)", lineNo, (int)tok.size());
        check(name, encOk);
        /* The decoder: those lines must turn back into exactly the frame. */
        std::string wire;
        for (size_t k = 0; k < tok.size(); k++) {
          std::string l;
          if (!decodeFixLine(tok[k], l)) {
            ok = false;
            break;
          }
          wire += l;
          wire += '\n';
        }
        SmpSerialDecoder dec;
        uint8_t out[HEARTH_SMP_PACKET_MAX];
        size_t gotLen = ok ? dec.feed((const uint8_t *)wire.data(), wire.size(), out, sizeof(out)) : 0;
        ok = ok && gotLen == frame.size() && gotLen > 0 && memcmp(out, frame.data(), frame.size()) == 0;
        snprintf(name, sizeof(name), "frame line %d: decoder turns the lines back into the frame bytes", lineNo);
        check(name, ok);
        i = (i + tok.size()) + 1;
        continue;
      }
      /* ---- cbor <cbor hex> <rc or -> <off or -> ---- */
      if (fl[i].compare(0, 5, "cbor ") == 0) {
        std::string rest = fl[i].substr(5);
        size_t sp = rest.find(' ');
        std::string hexS = sp == std::string::npos ? "" : rest.substr(0, sp);
        std::string rcOff = sp == std::string::npos ? "" : rest.substr(sp + 1);
        size_t sp2 = rcOff.find(' ');
        std::string rcS = sp2 == std::string::npos ? rcOff : rcOff.substr(0, sp2);
        std::string offS = sp2 == std::string::npos ? "" : rcOff.substr(sp2 + 1);
        std::vector<uint8_t> cbor;
        bool ok = parseHex(hexS, cbor);
        int32_t rc = -77;
        bool hasOff = false;
        uint32_t off = 0;
        ok = ok && smpDecodeResponse(cbor.data(), cbor.size(), rc, hasOff, off);
        bool wantRc = (rcS != "-");
        int32_t expRc = -1;
        if (wantRc) {
          expRc = 0;
          for (size_t k = 0; k < rcS.size(); k++) {
            if (rcS[k] < '0' || rcS[k] > '9') { expRc = -2; break; }
            expRc = expRc * 10 + (rcS[k] - '0');
          }
        }
        bool wantOff = (offS != "-");
        uint32_t expOff = 0;
        if (wantOff) {
          for (size_t k = 0; k < offS.size(); k++) {
            if (offS[k] < '0' || offS[k] > '9') { expOff = 0xFFFFFFFFu; break; }
            expOff = expOff * 10u + (uint32_t)(offS[k] - '0');
          }
        }
        ok = ok && wantRc && rc == expRc && hasOff == wantOff && (!wantOff || off == expOff);
        char name[96];
        snprintf(name, sizeof(name), "cbor line %d: reply map decodes to the oracle's rc/off", lineNo);
        check(name, ok);
        i++;
        continue;
      }
      char name[96];
      snprintf(name, sizeof(name), "smp_layers line %d: recognised line", lineNo);
      check(name, false);
      i++;
    }
  }

  /* ---- the encoder against the reference fixtures ---- */
  {
    std::string up0, echo;
    check("fixture smp_upload0.txt loads", loadFixture("fixtures/smp_upload0.txt", up0));
    check("fixture smp_echo.txt loads", loadFixture("fixtures/smp_echo.txt", echo));

    /* Drive the client's encoder through a full flash() with a scripted
     * stream, and compare the lines it sent against the fixtures. The
     * stream answers the echo (indefinite ENOTSUP) and each upload chunk
     * with the bootloader's offset, so the exchange completes. */
    ImgSource src;
    src.d = makeImage(600);
    const uint8_t sha[32] = {0};
    HearthCoprocPins pins;
    pins.reset = 2; pins.resetActiveLow = true;
    pins.strap = 3; pins.strapActiveLow = true;

    ScriptedSmpStream s;
    /* The replies are queued in the order the client's frames elicit
     * them (echo, chunk 0, chunk 1); each is released only when the
     * client has finished writing the request frame it answers, like a
     * real bootloader. */
    s.queueReply(encodeReplyLines(3, 0, 1, 0, REPLY_ECHO_INDEF, REPLY_ECHO_INDEF_LEN));
    s.queueReply(encodeReplyLines(3, 1, 2, 1, REPLY_UP_OFF448_INDEF, REPLY_UP_OFF448_INDEF_LEN));
    s.queueReply(encodeReplyLines(3, 1, 3, 1, REPLY_UP_OFF600_INDEF, REPLY_UP_OFF600_INDEF_LEN));

    g_yieldAdvanceMs = 50;
    HearthFlasherSmp f;
    int r = f.flash(s, pins, src, 0, 600, sha);
    g_yieldAdvanceMs = 0;
    check("flash completes over the scripted stream", r == 0);
    check("the echo line is byte-identical to smp.py's",
          !s.tx().empty() && s.tx()[0] == echo.substr(0, echo.find('\n')));
    check("the first upload line is byte-identical to smp.py's",
          s.tx().size() > 1 && s.tx()[1] == up0.substr(0, up0.find('\n')));
    /* The first line is compared by the check above; this one carries
     * only the last, so a first-line regression is not reported twice. */
    check("the first upload frame spans the fixture's 7 lines",
          s.tx().size() >= 8 &&
          s.tx()[7] == up0.substr(up0.rfind('\n', up0.size() - 2) + 1,
          up0.size() - 1 - (up0.rfind('\n', up0.size() - 2) + 1)));
    check("the stream received 10 lines (1 echo + 7 chunk0 + 2 chunk1)", s.lines() == 10);
    check("nothing was sent outside the script", s.unexpected().empty());
  }

  /* ---- the decoder: definite and indefinite reply maps ---- */
  {
    std::string echo, up0;
    loadFixture("fixtures/smp_echo.txt", echo);
    loadFixture("fixtures/smp_upload0.txt", up0);

    ImgSource src;
    src.d = makeImage(600);
    const uint8_t sha[32] = {0};
    HearthCoprocPins pins;
    pins.reset = 2; pins.resetActiveLow = true;
    pins.strap = 3; pins.strapActiveLow = true;

    ScriptedSmpStream s;
    s.queueReply(encodeReplyLines(3, 0, 1, 0, REPLY_ECHO_DEF, REPLY_ECHO_DEF_LEN));
    s.queueReply(encodeReplyLines(3, 1, 2, 1, REPLY_UP_OFF448_DEF, REPLY_UP_OFF448_DEF_LEN));
    s.queueReply(encodeReplyLines(3, 1, 3, 1, REPLY_UP_OFF600_INDEF, REPLY_UP_OFF600_INDEF_LEN));

    g_yieldAdvanceMs = 50;
    HearthFlasherSmp f;
    int r = f.flash(s, pins, src, 0, 600, sha);
    g_yieldAdvanceMs = 0;

    check("definite rc/off maps parse too", r == 0);
  }

  /* ---- a non-OK rc aborts with HEARTH_FLASH_ERR_PROTOCOL ---- */
  {
    std::string echo, up0;
    loadFixture("fixtures/smp_echo.txt", echo);
    loadFixture("fixtures/smp_upload0.txt", up0);

    ImgSource src;
    src.d = makeImage(600);
    const uint8_t sha[32] = {0};
    HearthCoprocPins pins;
    pins.reset = 2; pins.resetActiveLow = true;
    pins.strap = 3; pins.strapActiveLow = true;

    ScriptedSmpStream s;
    s.queueReply(encodeReplyLines(3, 0, 1, 0, REPLY_ECHO_INDEF, REPLY_ECHO_INDEF_LEN));
    s.queueReply(encodeReplyLines(3, 1, 2, 1, REPLY_UP_RC3_INDEF, REPLY_UP_RC3_INDEF_LEN));

    g_yieldAdvanceMs = 50;
    HearthFlasherSmp f;
    int r = f.flash(s, pins, src, 0, 600, sha);
    g_yieldAdvanceMs = 0;

    check("rc 3 aborts with HEARTH_FLASH_ERR_PROTOCOL", r == HEARTH_FLASH_ERR_PROTOCOL);
  }

  /* ---- entry failure: no reply at all, three attempts, then ERR_ENTER ---- */
  {
    ImgSource src;
    src.d = makeImage(600);
    const uint8_t sha[32] = {0};
    HearthCoprocPins pins;
    pins.reset = 2; pins.resetActiveLow = true;
    pins.strap = 3; pins.strapActiveLow = true;

    MockStream s;
    g_yieldAdvanceMs = 50;
    HearthFlasherSmp f;
    int r = f.flash(s, pins, src, 0, 600, sha);
    g_yieldAdvanceMs = 0;

    check("a silent co-processor gives HEARTH_FLASH_ERR_ENTER", r == HEARTH_FLASH_ERR_ENTER);
  }

  /* ---- the image magic is checked before the first chunk ---- */
  {
    ImgSource src;
    src.d = makeImage(600);
    src.d[0] ^= 0xFF;
    const uint8_t sha[32] = {0};
    HearthCoprocPins pins;
    pins.reset = 2; pins.resetActiveLow = true;
    pins.strap = 3; pins.strapActiveLow = true;

    MockStream s;
    g_yieldAdvanceMs = 50;
    HearthFlasherSmp f;
    int r = f.flash(s, pins, src, 0, 600, sha);
    g_yieldAdvanceMs = 0;

    check("a bad image magic is HEARTH_FLASH_ERR_SOURCE", r == HEARTH_FLASH_ERR_SOURCE);
    check("and nothing went on the wire", s.unexpected().empty());
  }

  /* ---- the pins: a strap or reset of -1 refuses with ERR_ENTER ---- */
  {
    ImgSource src;
    src.d = makeImage(600);
    const uint8_t sha[32] = {0};

    HearthCoprocPins noStrap;
    noStrap.reset = 2; noStrap.resetActiveLow = true;
    noStrap.strap = -1; noStrap.strapActiveLow = true;
    MockStream s;
    g_yieldAdvanceMs = 50;
    HearthFlasherSmp f;
    int r = f.flash(s, noStrap, src, 0, 600, sha);
    g_yieldAdvanceMs = 0;
    check("a strap of -1 refuses with HEARTH_FLASH_ERR_ENTER", r == HEARTH_FLASH_ERR_ENTER);

    HearthCoprocPins noReset;
    noReset.reset = -1; noReset.resetActiveLow = true;
    noReset.strap = 3; noReset.strapActiveLow = true;
    g_yieldAdvanceMs = 50;
    r = f.flash(s, noReset, src, 0, 600, sha);
    g_yieldAdvanceMs = 0;
    check("a reset of -1 refuses with HEARTH_FLASH_ERR_ENTER", r == HEARTH_FLASH_ERR_ENTER);
  }

  /* ---- the pin helpers' host behaviour ---- */
  {
    HearthCoprocPins ok;
    ok.reset = 2; ok.resetActiveLow = true;
    ok.strap = 3; ok.strapActiveLow = true;
    check("hearthCoprocStrap on a wired pin returns true", hearthCoprocStrap(ok, true));
    check("hearthCoprocStrap release returns true", hearthCoprocStrap(ok, false));
    check("hearthCoprocReset on a wired pin returns true", hearthCoprocReset(ok, 50));
    HearthCoprocPins none;
    none.reset = -1; none.resetActiveLow = true;
    none.strap = -1; none.strapActiveLow = true;
    check("hearthCoprocStrap on a -1 pin returns false", !hearthCoprocStrap(none, true));
    check("hearthCoprocReset on a -1 pin returns false", !hearthCoprocReset(none, 50));
  }

  /* ---- forModel: the two nRF strings in 5a, the rest nullptr ---- */
  {
    check("nRF54L15 Hearth -> a flasher", HearthFlasher::forModel("nRF54L15 Hearth") != nullptr);
    check("nRF54LM20A Hearth -> a flasher", HearthFlasher::forModel("nRF54LM20A Hearth") != nullptr);
    /* 5b registered the XMODEM client for the MG24; it is a different
     * instance from the SMP one, so this test (the SMP family) only
     * asserts it is not the SMP object. */
    check("MGM240P Hearth -> a flasher, not the SMP one (5b)",
          HearthFlasher::forModel("MGM240P Hearth") != nullptr &&
          HearthFlasher::forModel("MGM240P Hearth") != HearthFlasher::forModel("nRF54L15 Hearth"));
    check("ESP32-C6 Hearth -> nullptr in 5a and 5b", HearthFlasher::forModel("ESP32-C6 Hearth") == nullptr);
    check("an unknown model -> nullptr", HearthFlasher::forModel("Ophelia-IV") == nullptr);
    /* The result is a library-owned static: never deleted, and repeated
     * calls hand back the same instance. */
    check("forModel hands out a stable library-owned instance",
          HearthFlasher::forModel("nRF54L15 Hearth") == HearthFlasher::forModel("nRF54L15 Hearth"));
    check("both nRF strings share the one SMP instance",
          HearthFlasher::forModel("nRF54L15 Hearth") == HearthFlasher::forModel("nRF54LM20A Hearth"));
  }

  printf("\n===== RESULT: %d passed, %d failed =====\n", g_pass, g_fail);
  return g_fail ? 1 : 0;
}

/* test_flasher_esp.cpp: the ESP32-C6 ROM download loader (Task 5c) over the
 * vendored esp-serial-flasher. The port layer's primitives are driven one
 * at a time against a ByteStream (the binary stand-in for the C6's UART,
 * which records every written byte and answers only what it is fed), and
 * the full flash() sequence is checked against the silent-target oracle
 * in fixtures/esp_layers.txt.
 *
 * The fixtures were generated by the controller from esptool 4.12.0 (the
 * reference client of the ROM loader): the `sync` line is the SLIP-framed
 * SYNC request, and the `silent 10` line is exactly what a connect with
 * trials=10 writes to a target that never answers (10 SYNC requests and
 * nothing else). The vendored library was run against a capturing port by
 * the controller and wrote exactly those bytes, so the oracle is
 * verified: the host flash() of a silent target must reproduce them
 * byte for byte.
 *
 * The host clock moves only by g_yieldAdvanceMs and delay() (ArduinoShim.h):
 * every call that may wait (flash(), loader_port_read on an empty stream)
 * runs with g_yieldAdvanceMs set to 50 and restores it to 0 afterwards, so
 * a read timeout spins the simulated clock instead of hanging forever.
 */
#include <stdio.h>
#include <string.h>
#include <vector>
#include <string>

#include "ArduinoShim.h"
#include "ByteStream.h"
#include "HearthBundle.h"             /* HearthByteSource */
#include "HearthFlasher.h"
#include "HearthFlasherEsp.h"
#include "HearthFlasherEspInternal.h" /* hearthEspPortBind, hearthEspCanReclock */

/* The vendored library's public API (error codes, the port functions).
 * The configuration must be included first, as every C++ file that pulls
 * in esp_loader.h does: the two headers carry their own extern "C" guards. */
#include "vendor/esp_loader/esp_loader_hearth_config.h"
#include "vendor/esp_loader/esp_loader.h"
#include "vendor/esp_loader/esp_loader_io.h"

static int g_pass, g_fail;
static void check(const char *n, bool c) { printf("  [%s] %s\n", c ? "PASS" : "FAIL", n); (c ? g_pass : g_fail)++; }

/* A HearthByteSource over a memory buffer (the image bytes). */
class ImgSource : public HearthByteSource {
public:
  std::vector<uint8_t> d;
  bool read(uint32_t off, uint8_t *buf, size_t n) override {
    if ((size_t)off + n > d.size()) return false;
    memcpy(buf, &d[off], n);
    return true;
  }
  uint32_t size() const override { return d.size(); }
};

static bool loadFixture(const char *path, std::string &out) {
  FILE *f = fopen(path, "rb");
  if (!f) {
    std::string prefixed = std::string("test/host/") + path;
    f = fopen(prefixed.c_str(), "rb");
  }
  if (!f) return false;
  int c;
  out.clear();
  while ((c = fgetc(f)) != EOF) out.push_back((char)c);
  fclose(f);
  return true;
}

/* The fixture's "sync " and "silent 10 " hex fields, decoded to bytes. */
static int hexDigit(char c) {
  if (c >= '0' && c <= '9') return c - '0';
  if (c >= 'a' && c <= 'f') return c - 'a' + 10;
  if (c >= 'A' && c <= 'F') return c - 'A' + 10;
  return -1;
}
static bool parseHex(const std::string &s, std::vector<uint8_t> &out) {
  if (s.empty() || s.size() % 2 != 0) return false;
  out.clear();
  for (size_t i = 0; i < s.size(); i += 2) {
    int hi = hexDigit(s[i]), lo = hexDigit(s[i + 1]);
    if (hi < 0 || lo < 0) return false;
    out.push_back((uint8_t)((hi << 4) | lo));
  }
  return true;
}
/* Load the fixture and split its data lines (the "sync " and "silent N "
 * ones) into their hex fields. Returns false if the file did not load or
 * the two lines are missing. */
static bool loadOracles(std::vector<uint8_t> &sync, std::vector<uint8_t> &silent) {
  std::string fx;
  if (!loadFixture("fixtures/esp_layers.txt", fx)) return false;
  std::vector<std::string> fl;
  {
    std::string cur;
    for (size_t i = 0; i < fx.size(); i++) {
      if (fx[i] == '\n') { fl.push_back(cur); cur.clear(); }
      else cur.push_back(fx[i]);
    }
    if (!cur.empty()) fl.push_back(cur);
  }
  for (size_t i = 0; i < fl.size(); i++) {
    if (fl[i].empty() || fl[i][0] == '#') continue;
    if (fl[i].compare(0, 5, "sync ") == 0) parseHex(fl[i].substr(5), sync);
    else if (fl[i].compare(0, 10, "silent 10 ") == 0) parseHex(fl[i].substr(10), silent);
  }
  return !sync.empty() && !silent.empty();
}

/* The pins the C6 is wired with on the bench (any non-negative number
 * stands in on the host, where the pin helpers only report availability). */
static HearthCoprocPins espPins() {
  HearthCoprocPins p;
  p.reset = 2; p.resetActiveLow = true;
  p.strap = 3; p.strapActiveLow = true;
  return p;
}

int main() {
  /* ---- 1. port write: every byte to the bound stream, SUCCESS ---- */
  {
    ByteStream bs;
    hearthEspPortBind(&bs, espPins());
    uint8_t in[5] = {0xC0, 0x00, 0x01, 0xDB, 0x55};
    esp_loader_error_t e = loader_port_write(in, 5, 0);
    check("port write returns SUCCESS", e == ESP_LOADER_SUCCESS);
    check("port write put every byte on the stream (incl. 0xC0 and 0x00)", bs.tx().size() == 5 &&
          memcmp(bs.tx().data(), in, 5) == 0);
  }

  /* ---- 2. port read: all bytes in time -> SUCCESS; short read -> TIMEOUT, clock advances ---- */
  {
    ByteStream bs;
    hearthEspPortBind(&bs, espPins());
    bs.feed("\x01\x02\x03\x04\x05");
    uint8_t out[5] = {0};
    esp_loader_error_t e = loader_port_read(out, 5, 100);
    check("port read of 5 fed bytes returns SUCCESS", e == ESP_LOADER_SUCCESS);
    check("port read returned the 5 bytes in order", memcmp(out, "\x01\x02\x03\x04\x05", 5) == 0);

    /* Now the stream is empty. A read of 4 that can never be satisfied must
     * time out, and the simulated clock must advance at least the 100 ms
     * timeout and at most 200 ms (the 50 ms yield quantum bounds it). */
    uint32_t before = g_millis;
    uint8_t out2[4] = {0};
    g_yieldAdvanceMs = 50;
    esp_loader_error_t e2 = loader_port_read(out2, 4, 100);
    g_yieldAdvanceMs = 0;
    uint32_t adv = g_millis - before;
    check("port read of 4 from an empty stream returns TIMEOUT", e2 == ESP_LOADER_ERROR_TIMEOUT);
    check("the read timeout advanced the clock at least 100 ms and at most 200 ms",
          adv >= 100 && adv <= 200);
  }

  /* ---- 3. partial read: some bytes arrived, the rest did not -> TIMEOUT ---- */
  {
    ByteStream bs;
    hearthEspPortBind(&bs, espPins());
    bs.feed("\x0a\x0b");
    uint8_t out[4] = {0};
    g_yieldAdvanceMs = 50;
    esp_loader_error_t e = loader_port_read(out, 4, 100);
    g_yieldAdvanceMs = 0;
    check("a partial read (2 of 4 fed) returns TIMEOUT", e == ESP_LOADER_ERROR_TIMEOUT);
  }

  /* ---- 4. timer: start_timer / remaining_time on millis() ---- */
  {
    ByteStream bs;
    hearthEspPortBind(&bs, espPins());
    loader_port_start_timer(500);
    check("remaining right after start_timer(500) is 500", loader_port_remaining_time() == 500);
    delay(200);
    check("remaining after delay(200) is 300", loader_port_remaining_time() == 300);
    delay(400);
    check("remaining past the deadline is 0", loader_port_remaining_time() == 0);
  }

  /* ---- 5. the silent target, end to end ---- */
  {
    std::vector<uint8_t> sync, silent;
    bool ok = loadOracles(sync, silent);
    check("the silent-target oracles load from esp_layers.txt", ok);
    if (ok) {
      std::vector<uint8_t> img(3000);
      for (int i = 0; i < 3000; i++) img[i] = (uint8_t)(i & 0xFF);
      ImgSource src;
      src.d = img;
      const uint8_t sha[32] = {0};

      ByteStream bs;
      HearthFlasherEsp f;
      g_yieldAdvanceMs = 50;
      int r = f.flash(bs, espPins(), src, 0, 3000, sha);
      g_yieldAdvanceMs = 0;

      check("a silent C6 is HEARTH_FLASH_ERR_ENTER", r == HEARTH_FLASH_ERR_ENTER);
      check("the silent connect wrote exactly the oracle's 10 SYNC requests, no more, no rate change",
            bs.tx() == silent);
    }
  }

  /* ---- 6. the sync line: the first frame of the silent tx equals it ---- */
  {
    std::vector<uint8_t> sync, silent;
    if (!loadOracles(sync, silent)) { check("the sync oracle loads (recheck)", false); }
    else {
      std::vector<uint8_t> img(3000);
      for (int i = 0; i < 3000; i++) img[i] = (uint8_t)(i & 0xFF);
      ImgSource src;
      src.d = img;
      const uint8_t sha[32] = {0};

      ByteStream bs;
      HearthFlasherEsp f;
      g_yieldAdvanceMs = 50;
      int r = f.flash(bs, espPins(), src, 0, 3000, sha);
      g_yieldAdvanceMs = 0;

      bool framing = !bs.tx().empty() && (int)bs.tx().size() >= (int)sync.size() &&
                     memcmp(bs.tx().data(), sync.data(), sync.size()) == 0;
      check("the first frame written equals the fixture's SLIP-framed SYNC request", framing && r == HEARTH_FLASH_ERR_ENTER);
    }
  }

  /* ---- 7. pins of -1: refused before anything is written ---- */
  {
    std::vector<uint8_t> img(3000);
    for (int i = 0; i < 3000; i++) img[i] = (uint8_t)(i & 0xFF);
    ImgSource src;
    src.d = img;
    const uint8_t sha[32] = {0};

    HearthCoprocPins noReset;
    noReset.reset = -1; noReset.resetActiveLow = true;
    noReset.strap = 3; noReset.strapActiveLow = true;
    ByteStream bs;
    HearthFlasherEsp f;
    g_yieldAdvanceMs = 50;
    int r = f.flash(bs, noReset, src, 0, 3000, sha);
    g_yieldAdvanceMs = 0;
    check("a reset pin of -1 refuses with HEARTH_FLASH_ERR_ENTER, nothing written",
          r == HEARTH_FLASH_ERR_ENTER && bs.tx().empty());

    HearthCoprocPins noStrap;
    noStrap.reset = 2; noStrap.resetActiveLow = true;
    noStrap.strap = -1; noStrap.strapActiveLow = true;
    ByteStream bs2;
    g_yieldAdvanceMs = 50;
    int r2 = f.flash(bs2, noStrap, src, 0, 3000, sha);
    g_yieldAdvanceMs = 0;
    check("a strap pin of -1 refuses with HEARTH_FLASH_ERR_ENTER, nothing written",
          r2 == HEARTH_FLASH_ERR_ENTER && bs2.tx().empty());
  }

  /* ---- 8. forModel: the registry ---- */
  {
    HearthFlasher *c6 = HearthFlasher::forModel("ESP32-C6 Hearth");
    check("ESP32-C6 Hearth -> a flasher", c6 != nullptr);
    check("ESP32-C6 Hearth -> a stable library-owned static",
          HearthFlasher::forModel("ESP32-C6 Hearth") == c6);
    check("ESP32-C6 Hearth is a different instance from the nRF (SMP) one",
          c6 != HearthFlasher::forModel("nRF54L15 Hearth"));
    check("ESP32-C6 Hearth is a different instance from the MGM240P (XMODEM) one",
          c6 != HearthFlasher::forModel("MGM240P Hearth"));
    check("ESP32-C6 alone -> nullptr", HearthFlasher::forModel("ESP32-C6") == nullptr);
    check("an unknown model -> nullptr", HearthFlasher::forModel("Ophelia-IV") == nullptr);
  }

  printf("\n===== RESULT: %d passed, %d failed =====\n", g_pass, g_fail);
  return g_fail ? 1 : 0;
}
